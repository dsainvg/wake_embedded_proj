## main/Kconfig.projbuild
```kconfig
menu "INMP441 Microphone"

    config EXAMPLE_I2S_WS_GPIO
        int "I2S WS (LRCL) GPIO"
        default 40
        help
            INMP441 WS pin. Also drives the L/R channel select when tied to VDD/GND.

    config EXAMPLE_I2S_SCK_GPIO
        int "I2S SCK (BCLK) GPIO"
        default 41
        help
            INMP441 SCK pin.

    config EXAMPLE_I2S_SD_GPIO
        int "I2S SD (DOUT) GPIO"
        default 42
        help
            INMP441 SD (data out) pin.

    config EXAMPLE_SAMPLE_RATE
        int "Audio Sample Rate (Hz)"
        default 16000
        help
            ESP-SR WakeNet requires 16000 Hz. Do not change unless you change the model.

    config EXAMPLE_MIC_SAMPLE_SHIFT
        int "Right-shift applied to 32-bit I2S samples"
        range 8 24
        default 16
        help
            INMP441 sends 24 bits of two's complement audio left-justified in a
            32-bit I2S slot, i.e. bits 31..8. To get a full-scale int16 PCM
            sample you must discard the 8 unused low bits AND the 8 low bits of
            the real payload: shift right by 16.
            Use 14 to boost gain by 6 dB (clipping risk), 16 for correct range.

endmenu

menu "Wake Word Detection"

    config EXAMPLE_THRESHOLD
        float "Detection threshold"
        range 0.0 1.0
        default 0.796077
        help
            Frozen operating point read from models/best_m1g_wide.pt
            (0.796076774597168 at 0.5% FPR). Raising it trades recall for fewer false
            activations; lowering it does the reverse.

    config EXAMPLE_NEED
        int "Consecutive hits required to confirm"
        range 1 8
        default 2
        help
            Consecutive above-threshold hops required before a detection
            fires. Confirmation time is NEED x hop, so this is the latency /
            false-alarm lever; the hop itself is a CPU and cadence choice.
            At the shipped 200 ms hop and NEED=2 that is 400 ms.

            deploy_need from the checkpoint, and 78.73% TPR at 0.5% FPR was
            MEASURED at 2. Do not raise it: the keyword clears the threshold in
            at most ONE window out of 29 on synthesised speech, so 2-of-2
            already rejects it and 3-of-3 rejects everything -- measured, at
            thresholds from 0.60 to 0.796.

            A single isolated window is what a false positive looks like, which
            is the whole reason this gate exists. If detections are being
            missed, the threshold is the knob, not NEED -- but note the
            threshold encodes 0.5% FPR on real human speech, so lowering it
            trades away a measured false-alarm rate.

            1-of-2 gains 16-20 points of recall at low SNR but costs 16 FA/h.

    config EXAMPLE_HOLD_DECAY
        float "Peak-hold decay per window"
        range 0.0 1.0
        default 0.85
        help
            hold = max(p, hold * decay). Replaces the EMA the reference engine
            used before v6; an EMA cannot confirm a short keyword burst.

    config EXAMPLE_REFRACTORY_MS
        int "Refractory period after a detection (ms)"
        default 1500
        help
            Ignore further hits for this long. Derived from
            deploy_refractory_steps at the model's 100 ms stride.

    config EXAMPLE_HOP_MS
        int "Inference hop (ms)"
        range 20 1000
        default 200
        help
            How far the 1.6 s window advances per inference. This is the main CPU
            dial and it is now a BUDGET question, not a choice: an inference
            that overruns the hop drops audio continuously, because the task can
            never catch up.

            Measured on this model at 200 ms inference: 100 ms hop meant 239%
            duty and the sample clock fell behind without bound (drift 18.7 s
            after 30 s of running, 23.8% of the audio destroyed). 200 ms puts
            inference inside the hop, which is the first configuration in which
            the device actually keeps up with the room.

            The cost is confirmation latency: NEED consecutive hops are needed
            before a detection fires, so at NEED=2 this is 400 ms rather than
            200 ms. That is the trade, and it is the right one -- a detector
            that hears everything is worth less than one that hears the room.

    choice EXAMPLE_LED_TYPE
        prompt "Status LED type"
        default EXAMPLE_LED_TYPE_WS2812
        help
            GPIO48 on most ESP32-S3 devkits is an addressable RGB LED (WS2812).
            A plain GPIO toggle cannot light it - the driver has to send pixel
            data on the single data line. Pick PLAIN_GPIO only if you wired a
            discrete LED to the pin yourself.

        config EXAMPLE_LED_TYPE_WS2812
            bool "Addressable RGB LED (WS2812 / SK6812)"

        config EXAMPLE_LED_TYPE_GPIO
            bool "Plain GPIO LED"
    endchoice

    config EXAMPLE_LED_GPIO
        int "Status LED GPIO"
        default 48

    config EXAMPLE_LED_LED_COUNT
        int "Number of addressable LEDs"
        depends on EXAMPLE_LED_TYPE_WS2812
        default 1

    config EXAMPLE_LED_ACTIVE_LOW
        bool "Plain GPIO LED is active low"
        depends on EXAMPLE_LED_TYPE_GPIO
        default n
        help
            Enable if the LED anode is tied to 3V3.

endmenu

menu "Flash Clip Storage"

    config EXAMPLE_STORAGE_ENABLED
    bool "Store wake word clips to internal flash"
    default y
    help
            Keep a rolling 10-second PCM buffer in PSRAM and write it to the
            "storage" partition as a WAV file each time the wake word is detected.

    config EXAMPLE_CLIP_SECONDS
        int "Clip length to save (seconds)"
        range 2 30
        default 10
        help
            Total length of each saved WAV, measured from the end of the
            keyword. At 16 kHz 16-bit mono, 10 s is 320000 bytes.

    config EXAMPLE_PRE_ROLL_SECONDS
        int "Seconds of keyword tail kept at the front of the clip"
        range 0 5
        default 1
        help
            On detection the capture window opens with this many seconds of
            already-buffered audio, so the saved clip contains the tail of the
            keyword rather than starting cold right after it.
            0 = strictly the audio following the keyword.

    config EXAMPLE_STORAGE_PARTITION
        string "Storage partition label"
        default "storage"

endmenu
```
